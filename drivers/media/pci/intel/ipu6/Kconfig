## drivers/media/pci/intel/ipu6/Kconfig
```kconfig
config VIDEO_INTEL_IPU4
	tristate "Intel IPU4 driver"
	depends on ACPI || COMPILE_TEST
	depends on MEDIA_SUPPORT
	depends on MEDIA_PCI_SUPPORT
	depends on X86 && X86_64
	select IOMMU_IOVA
	select VIDEO_V4L2_SUBDEV_API
	select VIDEOBUF2_DMA_CONTIG
	select V4L2_FWNODE
	select AMBU_IPU_BRIDGE
	help
	  This is the 4th Gen Intel Image Processing Unit, found in Intel SoCs
	  and used for capturing images and video from camera sensors.

	  To compile this driver, say Y/m here! It contains 2 modules -
	  intel_ipu4 and intel_ipu4_isys.
```
