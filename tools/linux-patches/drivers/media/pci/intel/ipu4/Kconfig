## tools/linux-patches/drivers/media/pci/intel/ipu4/tests/Kconfig
```kconfig
# SPDX-License-Identifier: GPL-2.0-only
config VIDEO_INTEL_IPU4_KUNIT_TESTS
	tristate "KUnit tests for Intel IPU4 driver" if !KUNIT_ALL_TESTS
	depends on KUNIT && VIDEO_INTEL_IPU4
	default KUNIT_ALL_TESTS
	help
	  Small, fast unit tests for pure-logic code paths in the IPU4
	  driver: format-table lookup and Bayer ordering. Expected run
	  time is under one second under qemu-kvm via
	  tools/testing/kunit/kunit.py.
```

## tools/qemu-patches/hw/misc/Kconfig.ipu4
```kconfig
# Append to hw/misc/Kconfig during bootstrap:
config IPU4
    bool
    default y if PCI_DEVICES
    depends on PCI
```
